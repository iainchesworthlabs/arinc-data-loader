## CMakeLists.txt
```
# SPDX-License-Identifier: GPL-3.0-or-later
# A smoke test of the Zephyr platform layer on a Cortex-M3 (mps2/an385) under QEMU, built with the
# Zephyr SDK's GCC and picolibc, without exceptions. See src/main.cpp for what it checks and
# tools/ci/zephyr_qemu_smoke.sh for how it is built and run. The repository is a Zephyr module
# (zephyr/module.yml); CONFIG_ADL_LIBRARIES also links the 665 and 615A libraries, so that they are
# built for the board too.
cmake_minimum_required(VERSION 3.20.0)

get_filename_component(ADL_REPO_ROOT "${CMAKE_CURRENT_LIST_DIR}/../../.." ABSOLUTE)
list(APPEND ZEPHYR_EXTRA_MODULES "${ADL_REPO_ROOT}")

find_package(Zephyr REQUIRED HINTS $ENV{ZEPHYR_BASE})
project(adl_zephyr_smoke LANGUAGES C CXX)

target_sources(app PRIVATE src/main.cpp)
target_link_libraries(app PRIVATE
    adl::platform
    adl::arinc615a_runner
    adl::arinc615a
    adl::arinc665)
```

## prj.conf
```kconfig
# The smallest configuration the platform layer runs in: C++23 on the SDK's libstdc++ and
# picolibc, no exceptions and no RTTI, Zephyr's IPv4/UDP stack over its loopback interface.
CONFIG_CPP=y
CONFIG_STD_CPP23=y
CONFIG_REQUIRES_FULL_LIBCPP=y
CONFIG_PICOLIBC=y
CONFIG_CPP_EXCEPTIONS=n
CONFIG_CPP_RTTI=n

CONFIG_ADL_PLATFORM=y
CONFIG_ADL_WARNINGS_AS_ERRORS=y
CONFIG_ADL_HEAP_BYTES=262144
CONFIG_ADL_THREAD_STACK_BYTES=2048
CONFIG_MAIN_STACK_SIZE=8192
CONFIG_HEAP_MEM_POOL_SIZE=131072
CONFIG_DYNAMIC_THREAD_ALLOC=y
CONFIG_ZVFS_POLL_MAX=8

# The platform layer depends on a file system being configured; the smoke test mounts none.
CONFIG_FILE_SYSTEM=y

CONFIG_NETWORKING=y
CONFIG_NET_IPV4=y
CONFIG_NET_IPV6=n
CONFIG_NET_UDP=y
CONFIG_NET_TCP=n
CONFIG_NET_DRIVERS=y
CONFIG_NET_LOOPBACK=y
CONFIG_NET_SOCKETS=y
CONFIG_NET_MAX_CONTEXTS=8
CONFIG_NET_MAX_CONN=8
CONFIG_NET_PKT_RX_COUNT=16
CONFIG_NET_PKT_TX_COUNT=16
CONFIG_NET_BUF_RX_COUNT=64
CONFIG_NET_BUF_TX_COUNT=64
CONFIG_NET_LOG=n

# The network stack draws random port numbers; QEMU has no entropy device for it.
CONFIG_TEST_RANDOM_GENERATOR=y
```

## src/main.cpp
```c
// SPDX-License-Identifier: GPL-3.0-or-later
// A smoke test of the Zephyr platform layer on a board built with the Zephyr SDK's own toolchain
// (GCC, picolibc and its libstdc++, no exceptions): a Cortex-M3 under QEMU. It is not the
// conformance suite, which needs Catch2 and a file system and runs on native_sim
// (tests/platform/zephyr); it is the few things that show the platform layer compiles, links and
// runs on a real architecture, a real C library and a kernel configured for a small target: the
// clock, memory, a thread at every priority, a mutex, a semaphore, a message queue and UDP over
// Zephyr's loopback interface. It prints one "SMOKE:" line per check and ends with the count of
// failures, which tools/ci/zephyr_qemu_smoke.sh reads.

#include "adl/platform/host.hpp"

#include <zephyr/kernel.h>

#include <array>
#include <atomic>
#include <cstdint>
#include <cstdio>

using namespace adl::platform;
using namespace std::chrono_literals;

namespace
{

std::atomic<int> threads_run{0};
int failures = 0;

void check(bool ok, const char* what)
{
    std::printf("SMOKE: %s %s\n", ok ? "ok  " : "FAIL", what);
    if (!ok)
    {
        ++failures;
    }
}

void worker(void* argument) noexcept
{
    threads_run.fetch_add(1);
    (void)static_cast<Semaphore*>(argument)->post();
}

} // namespace

int main()
{
    auto made = make_host();
    if (!made)
    {
        std::printf("SMOKE: FAIL no host\n");
        std::printf("SMOKE: 1 failure(s)\n");
        return 1;
    }
    Host& host = **made;

    const Instant before = host.clock().now();
    host.clock().sleep_for(30ms);
    check(host.clock().now() - before >= 30ms, "sleep_for(30 ms) takes at least 30 ms");

    auto region = host.memory().acquire(1000, 64, MemoryUse::general);
    check(region.has_value() && reinterpret_cast<std::uintptr_t>(region->data()) % 64 == 0,
          "memory is 64 byte aligned");

    auto semaphore = host.threads().create_semaphore(0, 8);
    check(semaphore.has_value(), "a semaphore is made");
    if (semaphore)
    {
        for (const Priority level :
             {Priority::lowest, Priority::low, Priority::normal, Priority::high, Priority::highest})
        {
            ThreadSpec spec;
            spec.priority = level;
            spec.entry = &worker;
            spec.argument = semaphore->get();
            auto thread = host.threads().spawn(spec);
            check(thread.has_value() && (*thread)->priority_outcome() == PriorityOutcome::applied &&
                      (*semaphore)->wait(2s).has_value() && (*thread)->join().has_value(),
                  "a thread runs at a priority and is joined");
        }
        check(threads_run.load() == 5, "five threads ran");
    }

    auto mutex = host.threads().create_mutex();
    check(mutex.has_value(), "a mutex is made");
    if (mutex)
    {
        (*mutex)->lock();
        check(!(*mutex)->try_lock(), "try_lock by the holder fails");
        (*mutex)->unlock();
        check((*mutex)->try_lock(), "try_lock of a free mutex works");
        (*mutex)->unlock();
    }

    auto queue = host.ipc().create_queue(QueueSpec{16, 4, {}});
    const std::array<std::byte, 3> message{std::byte{1}, std::byte{2}, std::byte{3}};
    std::array<std::byte, 16> out{};
    check(queue.has_value() && (*queue)->send(message, 0ms).has_value() &&
              (*queue)->receive(out, 0ms).value_or(0) == 3 && out[2] == std::byte{3},
          "a message goes through a queue whole");

    UdpOptions options;
    options.local = Endpoint{Ipv4Address::loopback(), 0};
    auto first = host.network().open_udp(options);
    auto second = host.network().open_udp(options);
    check(first.has_value() && second.has_value(), "two UDP sockets are opened");
    if (first && second)
    {
        std::array<std::byte, 1400> payload{};
        payload[0] = std::byte{42};
        payload[1399] = std::byte{7};
        check((*first)->send_to((*second)->local_endpoint(), payload).has_value(), "a 1400 byte datagram is sent");
        std::array<std::byte, 2000> in{};
        const auto got = (*second)->receive_from(in, 2s);
        check(got.has_value() && got->size == 1400 && !got->truncated && in[0] == std::byte{42} &&
                  in[1399] == std::byte{7},
              "it arrives whole");
        const auto none = (*second)->receive_from(in, 50ms);
        check(!none.has_value() && none.error().code == ErrorCode::timeout, "a receive with nothing to read times out");
    }

    std::printf("SMOKE: %d failure(s)\n", failures);
    return failures == 0 ? 0 : 1;
}
```
